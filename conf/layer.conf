## conf/layer.conf
```bitbake
# We have a conf and classes directory, add to BBPATH
BBPATH =. "${LAYERDIR}:"

# We have recipes-* directories, add to BBFILES
BBFILES += "${LAYERDIR}/recipes-*/*/*.bb \
            ${LAYERDIR}/recipes-*/*/*.bbappend"

BBFILE_COLLECTIONS += "meta-seed-odyssey-stm32mp157c-basic"
BBFILE_PATTERN_meta-seed-odyssey-stm32mp157c-basic = "^${LAYERDIR}/"
BBFILE_PRIORITY_meta-seed-odyssey-stm32mp157c-basic = "5"

LAYERSERIES_COMPAT_meta-seed-odyssey-stm32mp157c-basic = "scarthgap"

LAYERDEPENDS_meta-seed-odyssey-stm32mp157c-basic = "core meta-linux-mainline"
```

## conf/machine/stm32mp15-odyssey-basic.conf
```bitbake
#@TYPE: Machine
#@NAME: stm32mp15-odyssey-basic
#@DESCRIPTION: Seed STM32MP157C Odyssey SoM SD card image basic boot
#@NEEDED_BSPLAYERS: layers/meta-linux-mainline

# Define specific familly common machine name
MACHINEOVERRIDES =. "stm32mp1common:stm32mp15common:"

# =========================================================================
# Chip architecture
# =========================================================================

DEFAULTTUNE = "cortexa7thf-neon-vfpv4"
include conf/machine/include/arm/armv7a/tune-cortexa7.inc

# =========================================================================
# Machine features
# =========================================================================

MACHINE_FEATURES += "watchdog"
MACHINE_FEATURES += "bluetooth"
MACHINE_FEATURES += "wifi"
MACHINE_FEATURES += "${@'gpu' if d.getVar('ACCEPT_EULA_'+d.getVar('MACHINE')) == '1' else ''}"
MACHINE_FEATURES += "m4copro"
MACHINE_FEATURES += "rtc"
MACHINE_FEATURES += "serial"
MACHINE_FEATURES += "usbhost"

# Bluetooth
BLUETOOTH_LIST += "linux-firmware-bluetooth-bcm43xx"
# Wifi
WIFI_LIST += "linux-firmware-bcm43430"

SERIAL_CONSOLES = "115200;ttySTM0"

# =========================================================================
# Kernel
# =========================================================================

KERNEL_IMAGETYPE = "fitImage"
KERNEL_CLASSES += "kernel-fitimage"

KBUILD_DEFCONFIG = "stm32_defconfig"
PREFERRED_PROVIDER_virtual/kernel ?= "linux-stable"
PREFERRED_VERSION_linux-stable ?= "6.17%"
KERNEL_DEVICETREE = "st/stm32mp157c-odyssey.dtb"

# Add DT overlays
KERNEL_DTC_FLAGS = " -@ "
PREFERRED_PROVIDER_virtual/dtb = "seeed-odyssey-stm32mp15-dt-overlay"

MACHINE_EXTRA_RRECOMMENDS += "u-boot-extlinux kernel-image kernel-modules kernel-devicetree seeed-odyssey-stm32mp15-dt-overlay linux-firmware-bcm43xx linux-firmware-bcm43430"
CORE_IMAGE_EXTRA_INSTALL += "kernel-image kernel-modules kernel-devicetree linux-firmware-bcm43xx linux-firmware-bcm43430"

# =========================================================================
# U-Boot
# =========================================================================

UBOOT_ENTRYPOINT = "0xc4000000"
UBOOT_LOADADDRESS = "0xc4000000"
UBOOT_DTB_LOADADDRESS = "0xc6000000"
UBOOT_DTBO_LOADADDRESS = "0xc6300000"
UBOOT_MACHINE = "stm32mp15-odyssey_basic_defconfig"
UBOOT_BINARY = "u-boot.img"
SPL_BINARY = "u-boot-spl.stm32"

EXTRA_IMAGEDEPENDS += "virtual/bootloader"
PREFERRED_PROVIDER_virtual/bootloader ?= "u-boot"
PREFERRED_VERSION_u-boot ?= "2025.10%"

# =========================================================================
# extlinux configuration
# =========================================================================

UBOOT_EXTLINUX = "1"
UBOOT_EXTLINUX_TIMEOUT = "20"
UBOOT_EXTLINUX_LABELS = "default"
UBOOT_EXTLINUX_MENU_DESCRIPTION:default = "Linux Default"
UBOOT_EXTLINUX_KERNEL_IMAGE:default = "/boot/fitImage#conf-stm32mp157c-odyssey.dtb#conf-stm32mp1-seeed-spi5-overlay.dtbo"
UBOOT_EXTLINUX_ROOT:default = "root=/dev/mmcblk0p4"
UBOOT_EXTLINUX_FDTDIR:default = ""
UBOOT_EXTLINUX_KERNEL_ARGS:default = "rootwait rw earlyprintk"

# =========================================================================
# WIC for sdcard raw image
# =========================================================================

WIC_CREATE_EXTRA_ARGS = "--no-fstab-update"

IMAGE_FSTYPES += "wic wic.bz2 wic.bmap"
WKS_FILE += "sdcard-odyssey-stm32mp157c-basic.wks.in"

WKS_FILE_DEPENDS:append = " ${EXTRA_IMAGEDEPENDS}"
```
